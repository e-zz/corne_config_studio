/* source keypos definitions */

/* map 6 extra keys */

/* activate bluetooth */
#define CONFIG_WIRELESS 1

/* source the main keymap */
#include "../../../corne.keymap"

/* use 6-column layout*/
/ { chosen { zmk,matrix_transform = &default_transform; }; };


